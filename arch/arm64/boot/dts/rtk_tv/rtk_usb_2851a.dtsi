/*
 * RTK TV usb host driver device tree in the 64 bits version;
 * including the base address, parameters of phy etc.
 *
 */

/ {
	#address-cells = <1>;
	#size-cells = <1>;
	rtk_usb: usb {
		compatible = "rtk,usb-platform";
		#address-cells = <2>;
		#size-cells = <2>;
	       ranges;
		ehci_top@18013000 {
			compatible = "rtk,ehci-top";
			reg = <0x00000000 0x18013000 0x00000000 0x400>;
            		interrupts = <GIC_SPI 21 IRQ_TYPE_LEVEL_HIGH>;
            		id = <0x0>;
            		usb2portcnt = <0x3>;
            		usb2_otp_names = "hw_usb_disconnect_level", "hw_usb_disconnect_done",
			                             "hw_usb_squelch_level", "hw_usb_squelch_done";
			                             
			usb2_otp_values = <0x0 0x4 0x0 0xe4 0x4>,/* otp_offset/bitsnum/page/reg/bits_offset */
							<0x0 0x4 0x0 0xe7 0x4>;
			usb2phys =     <0x1 0xf4 0xbb>,
					    <0x2 0xf4 0xbb>,
					    <0x3 0xf4 0xbb>,
					    <0x1 0xe5 0x0f>,
					    <0x2 0xe5 0x0f>,
					    <0x3 0xe5 0x0f>,
					    <0x1 0xe6 0x58>,
					    <0x2 0xe6 0x58>,
					    <0x3 0xe6 0x58>,
					    <0x1 0xe7 0xe3>,
					    <0x2 0xe7 0xe3>,
					    <0x3 0xe7 0xe3>,
					    <0x1 0xf4 0x9b>,
					    <0x2 0xf4 0x9b>,
					    <0x3 0xf4 0x9b>,
					    <0x1 0xe0 0x17>,
					    <0x2 0xe0 0x17>,
					    <0x3 0xe0 0x17>,
					    <0x1 0xe1 0x18>,
					    <0x2 0xe1 0x18>,
					    <0x3 0xe1 0x18>,
					    <0x1 0xe2 0x44>,
					    <0x2 0xe2 0x44>,
					    <0x3 0xe2 0x44>,
					    <0x1 0xe3 0xcd>,
					    <0x2 0xe3 0xcd>,
					    <0x3 0xe3 0xcd>,
					    <0x1 0xe5 0x63>,
					    <0x2 0xe5 0x63>,
					    <0x3 0xe5 0x63>,
					    <0x1 0xf4 0xbb>,
					    <0x2 0xf4 0xbb>,
					    <0x3 0xf4 0xbb>,
					    <0x1 0xe1 0x77>,
					    <0x2 0xe1 0x77>,
					    <0x3 0xe1 0x77>,
					    <0x1 0xf4 0xdb>,
					    <0x2 0xf4 0xdb>,
					    <0x3 0xf4 0xdb>,
					    <0x1 0xe7 0x44>,
					    <0x2 0xe7 0x44>,
					    <0x3 0xe7 0x44>,
					    <0x1 0xf4 0x9b>,
					    <0x2 0xf4 0x9b>,
					    <0x3 0xf4 0x9b>,
					    <0x1 0xe4 0x7a>,
					    <0x2 0xe4 0x7a>,
					    <0x3 0xe4 0x7a>,
					    <0x1 0xe7 0x71>,
					    <0x2 0xe7 0x71>,
					    <0x3 0xe7 0x71>,
					    <0x1 0xf4 0xbb>,
					    <0x1 0xe0 0x23>,
					    <0x1 0xe0 0x26>,
					    <0x2 0xf4 0xbb>,
					    <0x2 0xe0 0x23>,
					    <0x2 0xe0 0x26>,
					    <0x3 0xf4 0xbb>,
					    <0x3 0xe0 0x23>,
					    <0x3 0xe0 0x26>,
					    <0x1 0xf4 0x9b>,
					    <0x2 0xf4 0x9b>,
					    <0x3 0xf4 0x9b>,
					    <0x1 0xe4 0x7a>,
					    <0x2 0xe4 0x7a>,
					    <0x3 0xe4 0x7a>,
					    <0x1 0xe7 0x71>,
					    <0x2 0xe7 0x71>,
					    <0x3 0xe7 0x71>,
					    <0x1 0xe6 0x01>,
					    <0x2 0xe6 0x01>,
					    <0x3 0xe6 0x01>,
					    <0x1 0xf0 0xfc>,
					    <0x2 0xf0 0xfc>,
					    <0x3 0xf0 0xfc>,
					    <0x1 0xf1 0x8c>,
					    <0x2 0xf1 0x8c>,
					    <0x3 0xf1 0x8c>,
					    <0x1 0xf2 0x00>,
					    <0x2 0xf2 0x00>,
					    <0x3 0xf2 0x00>,
					    <0x1 0xf3 0x11>,
					    <0x2 0xf3 0x11>,
					    <0x3 0xf3 0x11>,
					    <0x1 0xf5 0x95>,
					    <0x2 0xf5 0x95>,
					    <0x3 0xf5 0x95>,
					    <0x1 0xf6 0x00>,
					    <0x2 0xf6 0x00>,
					    <0x3 0xf6 0x00>,
					    <0x1 0xf7 0xba>,
					    <0x2 0xf7 0xba>,
					    <0x3 0xf7 0xba>,
					    <0x1 0xf4 0xbb>,
					    <0x2 0xf4 0xbb>,
					    <0x3 0xf4 0xbb>,
					    <0x1 0xe2 0x00>,
					    <0x2 0xe2 0x00>,
					    <0x3 0xe2 0x00>,
					    <0x1 0xe3 0x03>,
					    <0x2 0xe3 0x03>,
					    <0x3 0xe3 0x03>,
					    <0x1 0xe4 0x48>,
					    <0x2 0xe4 0x48>,
					    <0x3 0xe4 0x48>,
					    <0x1 0xf4 0xdb>,
					    <0x2 0xf4 0xdb>,
					    <0x3 0xf4 0xdb>,
					    <0x1 0xe3 0x00>,
					    <0x2 0xe3 0x00>,
					    <0x3 0xe3 0x00>,
					    <0x1 0xf4 0x9b>,
					    <0x2 0xf4 0x9b>,
					    <0x3 0xf4 0x9b>;
		};

		ohci_top@18013400 {
			compatible = "rtk,ohci-top";
			reg = <0x00000000 0x18013400 0x00000000 0x400>;
			interrupts = <GIC_SPI 21 IRQ_TYPE_LEVEL_HIGH>;
			id = <0x0>;
		};
	};

  };
