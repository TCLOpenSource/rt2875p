/* rtk 6748 otp table */

/ {
	rtk_otp_table {
		compatible = "realtek,rtk-otp_table";
		func_boot_type_sel     = <512  0    4>;
		func_mem_obf_en        = <576  0    4>;
		chip_type_hdr_disable  = <930  1090 2>;
		chip_type_nnip_disable = <943  1103 1>;
		sw_func_mheg5          = <967  1127 1>;
		sw_func_hbbtv          = <969  1129 1>;
		sw_func_hbbtv_20_seraphic = <978 1138 1>;
		sw_func_hbbtv_20_vewd = <987 1147 1>;
		sw_func_ciplus         = <977  1137 1>;
		sw_func_ginga          = <980  1140 1>;
		sw_func_fvp            = <991  1151 1>;
		chip_type_remark_en    = <1247 0    1>;
		wafer_info_slot        = <1312 0    69>;
		wafer_info_all         = <1328 0    64>;
		hw_usb_disconnect_level = <1904 0    16>;
		hw_usb_squelch_level    = <1888 0    16>;
		hw_usb_swing_level      = <1864 0    20>;
		hw_usb_disconnect_done  = <1939 0    1>;
		hw_usb_squelch_done     = <1938 0    1>;
		hw_usb_swing_done       = <1884 0    1>;
		hw_emmc_ldo_trim_info   = <1575 0    3>;
		rtk_otp_debug_field     = <520  0    4>;
		hw_ifd_iadc_ldo         = <1588 0    4>;
		hw_ifd_qadc_ldo         = <1592 0    4>;
		hw_cpu_package_size     = <2472 0    3>;
		hw_ddr_info             = <1248 0    32>;
		chip_type_ve_avs3_disable =<947 1107 1>;
		chip_type_edp_tx_disable = <958 1118 1>;
		chip_type_dp_rx_disable =<948 1108 1>;
		chip_type_cuva_hdr_disable = <945 1105 1>;
		chip_type_usb_c_bb_disable = <951 1111 1>;
		chip_type_usb_c_pd_disable = <959 1119 1>;
		io_pcmcia_disable = <608 0 4>;
		io_sc_disable = <620 0 4>;
		io_pcmcia1_disable = <640 0 4>;
		io_sc1_disable = <644 0 4>;
		chip_type_ve_vvc_disable = <946 1106 1>;
		mp_status_dp_rx_aux_tx_z0=<3052 0 5>;
		mp_status_dp_rx_aux_tx_z0_done=<3057 0 1>;
		mp_status_dp_rx_aux_rx_z0=<3058 0 5>;
		mp_status_dp_rx_aux_rx_z0_done=<3063 0 1>;
		hw_dp_rx_aux_rx_vth=<1548 0 6>;
		hw_dp_rx_aux_rx_vth_done=<1554 0 1>;
		hw_mp_status_ft_iddq_done = <2480 0 3>;
		hw_iddq_core_power = <1920 0 9>;
		hw_iddq_scpu_power = <1929 0 9>;
		sw_func_virtual_camera = <990 1150 1>;
		hw_q_vcm_sel_ft_done = <1942 0 1>;
		hw_q_vcm_sel_ft = <1940 0 2>;
		hw_vd_adc_ldo           = <1596 0    4>;
		chip_type_memc_disable = <937 1097 1>;
		sw_func_hdr_10_plus = <944 1104 1>;
		hw_hdmi_rx_z0           = <1600 0    18>;
		hw_ypp_ldo = <1624 0 8>;
		sw_func_set_type         = <985  1145 2>;
	};
};
