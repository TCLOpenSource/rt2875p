## drivers/rtk_kdriver/demod/rtd2851a/Kconfig
```kconfig
config RTK_KDRV_DEMOD
	tristate "DTV Demod Driver"
	depends on RTK_KDRIVER_SUPPORT	
	default n
	help	  

config RTK_KDRV_KHAL_DEMOD
	tristate "DTV KHAL Demod Driver "
	depends on RTK_KDRIVER_SUPPORT
	default n
	help
	
config RTK_KDRV_DEMOD_TEST
	tristate "DTV Demod Test"
	depends on RTK_KDRV_DEMOD
	default n
	help

	 Dummy flag

config RTK_KDRV_DEMOD_SCAN_THREAD_ENABLE
	tristate "DTV Demod Driver Scan Thread"
	depends on RTK_KDRIVER_SUPPORT	
	default n
	help	  
```

## drivers/rtk_kdriver/demux/Kconfig
```kconfig
config RTK_KDRV_DEMUX
	tristate  "Driver for Demux HAL Manager"
	default n
	help
	  Driver for Demux HAL Manager
```

## drivers/rtk_kdriver/dft/Kconfig
```kconfig
config RTK_KDRV_DFT
	tristate "DFT (phase scan) driver."
	depends on RTK_KDRIVER_SUPPORT
	default n
	help
		DFT Driver
```

## drivers/rtk_kdriver/dolby_idk_1_6_1_1/Kconfig
```kconfig
config DOLBY_VISION_SECURITY_MODE
	bool "Dolby Vision Security Mode"
	depends on RTK_KDRV_DV
	default n
	help
	  Dolbyvision Engine

config DOLBY_VISION_SECURITY_MODE_DEMO
	bool "demo for dolby security function"
	depends on RTK_KDRV_DV
	default n
	help
	  Dolbyvision Engine
```

## drivers/rtk_kdriver/dprx/Kconfig
```kconfig
menu "DP RX"

config RTK_DPRX
	tristate "Enable DPRX Support"
	default n
	help
		Enable DPRX

config DPRX_VFE_ENABLE_VFE_STATE_CHECK
	default y

config DPRX_VFE_ENABLE_QUICK_SHOW
	bool "Enable DPRX QUICK Show"
	default y

config DPRX_VFE_ENABLE_ONLINE_MEASURE_ERROR
	bool "Enable DPRX online measure error"
	depends on RTK_DPRX
	default y

config DPRX_VFE_ENABLE_HPD_LOW_GUARD_INTERVAL
    bool "Enable DPRX HPD LOW Guard Interval"
	default y

config DPRX_GET_IC_VERSION
	bool "Enable GET IC Version"
	default y

config DPRX_FORCE_CHECK_MODE_FAIL_CABLE_OFF_ON
	bool "Force Cable off/on when check mode fail"
	depends on RTK_DPRX
	default n

config DPRX_STATUS_MONITOR
	bool "Force DPRX Status Monitor"
	depends on RTK_DPRX
	default y

config DPRX_EANBLE_FREESYNC
	bool "Enable FreeSync"
	depends on RTK_DPRX
	default y

config DPRX_EANBLE_FEC
	bool "Enable FEC"
	depends on RTK_DPRX
	default n

config DPRX_FORCE_EANBLE_WAKEUP_BY_AUX
	bool "Force Enable Wakeup by Aux"
	depends on RTK_DPRX
	default y

config SUPPORT_GET_DRM_INFO
	bool "Support Get DRM info"
	depends on RTK_DPRX
	default y

config RTK_DPRX_SYSFS
	bool "Enable DPRX SYSFS"
	default y
	help
		Enable DPRX SYSFS

config DPRX_DRV_ENABLE_RTK_DPRX_ADAPTER
	bool "Enable RTK DPRX adpter"
	select DPRX_DRV_USE_EXTERNAL_EXT_DRVIF
	default y
	help
		Add RTK DPRX Adapter support

config ENABLE_TYPEC_DPRX
	bool "Enable TYPEC DPRX adpter"
	default y

config DPRX_BUILD_IN_TEST
	bool "Enable DPRX Build in test"
	depends on DPRX_DRV_ENABLE_RTK_DPRX_ADAPTER && RTK_DPRX_SYSFS
	default y
	help
		Enable DPRX Build in test

menu "RTK DPRX Driver"
source "drivers/rtk_kdriver/dprx/Kconfig.dprx_drv"
endmenu

endmenu
```

## drivers/rtk_kdriver/dprx/Kconfig.dprx_drv
```kconfig
config BUILD_DPRX_DRV
        bool "BUILD Display Port RX driver"
        depends on DPRX_DRV_ENABLE_RTK_DPRX_ADAPTER
        default n
        help
                BUILD DPRX low level driver

choice
	prompt "DPRX_DRV_PRJ_CFG"
	depends on DPRX_DRV_ENABLE_RTK_DPRX_ADAPTER
       	help

config DPRX_PRJ_MAC8P_KDRV
	bool "DPRX DRV for Mac8P"
	depends on DPRX_DRV_ENABLE_RTK_DPRX_ADAPTER
	default y

config DPRX_PRJ_RTD2885P_KDRV
	bool "DPRX DRV for RTD2885P"
	depends on DPRX_DRV_ENABLE_RTK_DPRX_ADAPTER

endchoice

config DPRX_DRV_USE_EXTERNAL_EXT_DRVIF
	depends on DPRX_DRV_ENABLE_RTK_DPRX_ADAPTER
	bool
	default y

config DPRX_DRV_ENABLE_VIRTUAL_PLATFORM
	bool "Enable DPRX Virtual platform"
	depends on BUILD_DPRX_DRV
	default n
	help
		Running DPRX on Virtual Platform

config DPRX_DRV_ENABLE_HDCP
	bool "Enable DRPX Driver HDCP Support"
	depends on BUILD_DPRX_DRV
	default y
	help
		Enable DRPX Driver HDCP Support

config DPRX_DRV_ENABLE_PHY
	bool "Enable DPRX PHY"
	depends on BUILD_DPRX_DRV
	default y

config DPRX_DRV_ENABLE_AUDIO
	bool "Enable DPRX Audio"
	depends on BUILD_DPRX_DRV
	default y

config DPRX_DRV_ENABLE_HDCP_CALCULATE_R0_BY_FW
	bool "Enable HDCP CALCULATE R0 BY FW"
	depends on BUILD_DPRX_DRV
	default y
```

## drivers/rtk_kdriver/dscd/Kconfig
```kconfig
menu "DSCD"

config RTK_DSCD
	tristate "Enable dscd Support"
	default y
	help
		Enable dscd

endmenu
```

## drivers/rtk_kdriver/etn/Kconfig
```kconfig
#ETN driver
config RTK_KDRV_R8168
	tristate "Realtek 8168 gigabit ethernet support"
	select FW_LOADER
	select CRC32
	select NET_CORE
	select MII
	select RTK_KDRIVER
	depends on ETHERNET
	depends on RTK_KDRIVER_SUPPORT
	default y if !ARCH_RTK289X
	help
	  Say Y here if you have a Realtek 8168 Gigabit Ethernet adapter.

	  To compile this driver as a module, choose M here: the module
	  will be called r8168.  This is recommended.

config RTK_KDRV_8168_EVENT
    	bool "Use kobject link down/up event"
	depends on RTK_KDRV_R8168
    	default n
    	help
      	  If you want to use kobject link down/up event, say Y.
```

## drivers/rtk_kdriver/extcon/Kconfig
```kconfig
#Copyright (C) 2007-2013 Realtek Semiconductor Corporation.
# drivers/rtk_kdriver/extcon/Kconfig

config RTK_KDRV_EXTCON
	tristate "GPIO Extcon  device interface"
	depends on EXTCON
	help
	  GPIO Switch Device Driver
```

## drivers/rtk_kdriver/gadget/Kconfig
```kconfig
config RTK_KDRV_USB_GADGET
    tristate "RTK USB GADGET DEVICE SUPPORT"
    select USB_GADGET
    help
      This is for Realtek USB Gadget devices.

config RTK_KDRV_USB_GADGET_HID
    tristate "RTK USB GADGET DEVICE SUPPORT"
    depends on RTK_KDRV_USB_GADGET
    help
      This is for Realtek USB Gadget HID device.
```

## drivers/rtk_kdriver/gal/Kconfig
```kconfig
#SE driver
config RTK_KDRV_SE
	tristate "SE (2D Graphic/Streaming Engine) Driver."
	depends on RTK_KDRIVER_SUPPORT
	select RTK_KDRIVER
	default n
	help
		For drawing

#GDMA drvier
config RTK_KDRV_GDMA
	tristate "GDMA Driver"
	depends on RTK_KDRIVER_SUPPORT
	select RTK_KDRIVER
	default n
	help
		For display

config RTK_KDRV_REFDECMP
	tristate "decmp Driver"
        depends on RTK_KDRIVER_SUPPORT
        select RTK_KDRIVER
        default n
        help
                For display

#GDMA drvier
config RTK_KDRV_GDMA_RLINK
       bool "GDMA Rlink Driver"
       depends on RTK_KDRIVER_SUPPORT
       select RTK_KDRIVER
       default n
       help
               For display

config RTK_KDRV_GDMA_SPLIT_2
       bool "GDMA Split mode 2"
       depends on RTK_KDRIVER_SUPPORT
       select RTK_KDRIVER
       default n
       help
               For display
			   
config RTK_KDRV_GDMA_SPLIT_3
       bool "GDMA Split mode 3"
       depends on RTK_KDRIVER_SUPPORT
       select RTK_KDRIVER
       default n
       help
               For display

#GAL driver
config RTK_KDRV_GAL
	bool "GAL Driver"
	depends on RTK_KDRIVER_SUPPORT && RTK_KDRV_SE && RTK_KDRV_GDMA && ION_REALTEK
	select RTK_KDRIVER
	default n
	help
		For kadapter
```
