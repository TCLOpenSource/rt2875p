## drivers/rtk_kdriver/svad/Kconfig
```kconfig
config RTK_KDRV_SVAD
	tristate "Driver for SVAD Manager"
	default n
	depends on RTK_KDRV_I2C
	depends on RTK_KDRV_I2C_ALGO_RTK
	help
	  Driver for SVAD Manager
```

## drivers/rtk_kdriver/thermal/Kconfig
```kconfig
menu "Realtek Thermal Support"

if THERMAL
config RTK_KDRV_THERMAL_SENSOR
	depends on RTK_KDRIVER_SUPPORT
	tristate "Realtek thermal management"
	default n
	help
		Realtek thermal sensor
endif

config RTK_KDRV_DYNAMIC_REFRESH_SETTING
	bool "Dynamic referesh rate setting"
	depends on RTK_KDRV_THERMAL_SENSOR
	default n
	help
		Base on different thermal value,
		adjust setting for Dram refresh rate dynamically.
endmenu
```

## drivers/rtk_kdriver/tp/Kconfig
```kconfig
config RTK_KDRV_TP
	tristate "TP Driver (MPEG2-Transport)"
	select RTK_KDRV_CW
	depends on RTK_KDRIVER_SUPPORT
	default n		  

source "drivers/rtk_kdriver/tp/$(CHIP_NAME)/Kconfig"
```

## drivers/rtk_kdriver/tp/rtd2851a/Kconfig
```kconfig
config RTK_KDRV_MULTI_TP_CLOCK
	bool "Enable multiple tp clock"
	depends on RTK_KDRV_TP
	default y if RTK_KDRV_TP
	help
		Enable multiple tp clock.
```

## drivers/rtk_kdriver/tp/rtd2851c/Kconfig
```kconfig
config RTK_SUPPORT_TWO_HWTLV
	bool "hw tlv filter Support"
	depends on RTK_KDRV_TP
	default n
```

## drivers/rtk_kdriver/tp/rtd6702/Kconfig
```kconfig
config RTK_TP_WITH_MIO
	bool "TP_WITH_MIO Support"
	depends on RTK_KDRV_TP && RTK_KDRV_MIO
	default y

config RTK_SUPPORT_TWO_HWTLV
	bool "hw tlv filter Support"
	depends on RTK_KDRV_TP
	default y

config RTK_SUPPORT_HWTLV_FILTER
	bool "hw tlv filter Support"
	depends on RTK_KDRV_TP
	default y

config RTK_KDRV_MULTI_TP_CLOCK
	bool "Enable multiple tp clock"
	depends on RTK_KDRV_TP
	default y if RTK_KDRV_TP
	help
		Enable multiple tp clock.
```

## drivers/rtk_kdriver/tp/rtd6748/Kconfig
```kconfig
config RTK_SUPPORT_TWO_HWTLV
	bool "hw tlv filter Support"
	depends on RTK_KDRV_TP
	default y

config RTK_KDRV_MULTI_TP_CLOCK
	bool "Enable multiple tp clock"
	depends on RTK_KDRV_TP
	default y if RTK_KDRV_TP
	help
		Enable multiple tp clock.
```

## drivers/rtk_kdriver/tvscalercontrol/Kconfig
```kconfig
source "drivers/rtk_kdriver/tvscalercontrol/$(CHIP_NAME)/Kconfig"
source "drivers/rtk_kdriver/tvscalercontrol/$(CHIP_NAME)/hdmirx/Kconfig"
```

## drivers/rtk_kdriver/tvscalercontrol/rtd2851a/Kconfig
```kconfig
config SUPPORT_SCALER
	bool "Scaler Driver"
	default y
	select RTK_HDMI_RX
	help
		SUPPORT Scaler Driver

config USE_SHARE_COMMON
    bool "Use Share Common"
    default n
    help
        SUPPORT New Common

config KDRIVER_USE_NEW_COMMON
    bool "Use New Common"
    default y
    help
        SUPPORT New Common

config HDCP2_USE_DEFAULT_HDCP_KEY
	bool "HDCP2 Use default HDCP Key"
	default n
	help
		Use default HDCP Key for bringup

if SUPPORT_SCALER
config SUPPORT_SRC_VGA
	bool "Support Source VGA"
	default y
	help
		SUPPORT Source VGA

config ENABLE_3D_SETTING
	bool "Enable VDC 3D YC Separation"
	default y
	help
		3D YC Separation

config DYNAMIC_ALLOCATION_SCALER_MEMORY
	bool "Enable dynamic memory allocation"
	default y
	help
		SUPPORT memory dynamic allocation

config DUAL_CHANNEL
	bool "Enable dual channel"
	default n
	help
		dual chanel open for pip


config ENABLE_VD_27MHZ_MODE
	bool "Enable VD 27MHz mode"
	default y
	help
		enable VD 27MHz mode

config FIX_CKILL_MODE
	bool "Fix ckill mode"
	default y
	help
		Fix ckill mode
endif

config RTK_KDRV_HDMI_ENABLE_V4L2
	bool "Enable HDMI V4L2 Support"
	default y
	help
	  Enable HDMI V4L2 Support


config MEMC
    bool "Enable MEMC"
    default n
    help
        Provide realtek MEMC.

config SUPPORT_SDR_MAX_RGB
	bool "support SDR max RGB"
	default n
	help
	  Enable support SDR max RGB

config RTK_GAMUT_SUPPORT
    bool "Enable Gamut Mode"
    default y
    help
        Provide realtek turnkey gamut.

config RTK_SW_OUTGAMMA_CT
    bool "Enable software output gamma color tempurature"
    default y
    help
        Provide realtek turnkey software output gamma color tempurature.
		
config SUPPORT_COLORSYSTEM_MANUAL_SET
    bool "Enable support manual change Colorsystem display didn't No Signal"
    default n
    help
        Enable support manual change Colorsystem display didn't No Signal.

config SUPPORT_SRC_DPRX
	bool "Support Source DPRX"
	depends on RTK_DPRX
	default y
	help
		SUPPORT Source DPRX
```

## drivers/rtk_kdriver/tvscalercontrol/rtd2851a/hdmirx/Kconfig
```kconfig
menu "HDMI RX"

config RTK_HDMI_RX
	bool "Enable HDMI RX MAC"
	default n
	select RTK_KDRV_GPIO
	select RTK_KDRV_DDC
	help
		Enable HDMI RX MAC

config RTK_KDRV_HDMI_ENABLE_PHY
	bool "Enable HDMI PHY Support"
	default y
	depends on RTK_HDMI_RX 
	help
		Enable PHY Support

config RTK_KDRV_HDMI_ENABLE_DYNAMIC_POWER_SAVING
	bool "Enable HDMI Dynamic Power Saving"
	default n
	depends on RTK_HDMI_RX 
	help
	  Enable HDMI Dynamic Power Saving	  

config OPTEE_HDCP2
	bool "Enable OPTEE_HDCP2"
	default n
	help
		Enable OPTEE_HDCP2

config OPTEE_HDCP14
	bool "Enable OPTEE_HDCP14"
	default n
	help
		Enable OPTEE_HDCP14

config ENABLE_DOLBY_VISION_HDMI_AUTO_DETECT
	bool "Enable Dolby Vision HDMI Auto Detect"
	default n
	depends on RTK_HDMI_RX && SUPPORT_SCALER 
	help
		Enable Dolby Vision HDMI Auto Detect

config ENABLE_DOLBY_VISION_VSEM
	bool "Enable Dolby Vision VSEM Receieve"
	default n
	depends on ENABLE_DOLBY_VISION_HDMI_AUTO_DETECT 
	help
		Enable Dolby Vision Vendor Specific EMP RX

config ENABLE_HDR10_HDMI_AUTO_DETECT
	bool "Enable HDR10 HDMI Auto Detect"
	default n
	depends on RTK_HDMI_RX 
	help
		Enable HDR10 HDMI Auto Detect

config HDMI_DRV_HPD
	bool "Enable HDMI_DRV_HPD"
	default n
	help
		Provide realtek HDMI_DRV_HPD.

config HDMI_RX_BUILT_IN_TEST
        bool "Enable HDMI RX Built in test"
        default y
        help
                Enable HDMI RX Built in test.

#source drivers/rtk_kdriver/tvscalercontrol/hdmirx/bist/Kconfig	
		
endmenu
```

## drivers/rtk_kdriver/tvscalercontrol/rtd2885p/hdmirx/Kconfig
```kconfig
menu "HDMI RX"

config RTK_HDMI_RX
	tristate "Enable HDMI RX MAC"
	default n
	select RTK_KDRV_GPIO
	select RTK_KDRV_DDC
	help
		Enable HDMI RX MAC

config RTK_KDRV_HDMI_ENABLE_HDMI21
	bool "Enable HDMI 2.1 Support"
	default y
	depends on RTK_HDMI_RX 
	help
	  Enable HDMI 2.1 Support

config RTK_KDRV_HDMI_ENABLE_PHY
	bool "Enable HDMI PHY Support"
	default y
	depends on RTK_HDMI_RX 
	help
		Enable PHY Support

config RTK_KDRV_HDMI_ENABLE_DYNAMIC_POWER_SAVING
	bool "Enable HDMI Dynamic Power Saving"
	default y
	depends on RTK_HDMI_RX 
	help
	  Enable HDMI Dynamic Power Saving	  

config RTK_KDRV_HDMI_HDCP_REPEATER_ENABLE
	bool "Enable HDMI HDCP Repeater"
	default n
	depends on RTK_HDMI_RX
	help
		Enable HDMI HDCP Repeater function

config ENABLE_DOLBY_VISION_HDMI_AUTO_DETECT
	bool "Enable Dolby Vision HDMI Auto Detect"
	default n
	depends on RTK_HDMI_RX 
	help
		Enable Dolby Vision HDMI Auto Detect

config ENABLE_DOLBY_VISION_VSEM
	bool "Enable Dolby Vision VSEM Receieve"
	default n
	depends on ENABLE_DOLBY_VISION_HDMI_AUTO_DETECT 
	help
		Enable Dolby Vision Vendor Specific EMP RX

config ENABLE_HDR10_HDMI_AUTO_DETECT
	bool "Enable HDR10 HDMI Auto Detect"
	default n
	depends on RTK_HDMI_RX 
	help
		Enable HDR10 HDMI Auto Detect

config HDMI_DRV_HPD
	bool "Enable HDMI_DRV_HPD"
	default n
	help
		Provide realtek HDMI_DRV_HPD.

config HDMI_RX_BUILT_IN_TEST
        bool "Enable HDMI RX Built in test"
        default y
        help
                Enable HDMI RX Built in test.

config RTK_8KCODEC_HDMI_SOUND_WORKAROUND
        bool "2893 hdmi sound workaround, 5v hotplug, audio only"
        default n
        help
               2893 hdmi sound workaround, 5v hotplug, audio only

#source drivers/rtk_kdriver/tvscalercontrol/hdmirx/bist/Kconfig	
		
endmenu
```

## drivers/rtk_kdriver/tvscalercontrol/rtd6702/Kconfig
```kconfig
config SUPPORT_SCALER
	tristate "Scaler Driver"
	default y
	select RTK_HDMI_RX
	help
		SUPPORT Scaler Driver

config USE_SHARE_COMMON
    bool "Use Share Common"
    default n
    help
        SUPPORT New Common

config KDRIVER_USE_NEW_COMMON
    bool "Use New Common"
    default y
    help
        SUPPORT New Common

config HDCP2_USE_DEFAULT_HDCP_KEY
	bool "HDCP2 Use default HDCP Key"
	default n
	help
		Use default HDCP Key for bringup

if SUPPORT_SCALER
config SUPPORT_SRC_ADC
	bool "Support Source ADC"
	default y
	help
		SUPPORT Source ADC

if SUPPORT_SRC_ADC
config SUPPORT_SRC_VGA
	bool "Support Source VGA"
	default y
	help
		SUPPORT Source VGA
endif

config ENABLE_3D_SETTING
	bool "Enable VDC 3D YC Separation"
	default y
	help
		3D YC Separation

config DYNAMIC_ALLOCATION_SCALER_MEMORY
	bool "Enable dynamic memory allocation"
	default y
	help
		SUPPORT memory dynamic allocation

config DUAL_CHANNEL
	bool "Enable dual channel"
	default y
	help
		dual chanel open for pip


config ENABLE_VD_27MHZ_MODE
	bool "Enable VD 27MHz mode"
	default y
	help
		enable VD 27MHz mode

config FIX_CKILL_MODE
	bool "Fix ckill mode"
	default y
	help
		Fix ckill mode

config ENABLE_HDMITX
    bool "Enable HDMITX Support"
    default n
    help
        Support HDMITX output

config ENABLE_MARK2_ZEBU_BRING_UP
    bool "Enable HDMITX on ZEBU platform Support"
    default n
    help
        Support Mark2 HDMITX work on ZEBU platform

config HDMITX_20_21_HDCP_SUPPORT
	bool "HDMI 2.0/2.1 TX HDCP support"
	depends on ENABLE_HDMITX
	default n
	help
		H5X HDMI 2.0/2.1 TX HDCP support
endif

config RTK_KDRV_HDMI_ENABLE_V4L2
	bool "Enable HDMI V4L2 Support"
	default y
	help
	  Enable HDMI V4L2 Support

config RTK_KDRV_SVP_HDMI_PROTECTION
	bool "Enable HDMI secure protection"
	depends on OPTEE_SECURE_SVP_PROTECTION
	default n
	help
	  Enable HDMI secure protection

config MEMC
    bool "Enable MEMC"
    default n
    help
        Provide realtek MEMC.

config SUPPORT_SDR_MAX_RGB
	bool "support SDR max RGB"
	default y
	help
	  Enable support SDR max RGB		

config SUPPORT_IPQ
	bool "support IPQ"
	default n
	help
	  Enable support IPQ

config OSD_VALUE_NO_NEED_MAP_RANGE
	bool "OSD VALUE NO NEED MAP RANGE"
	default n
	help
	  Enable OSD VALUE NO NEED MAP RANGE

config RTK_GAMUT_SUPPORT
    bool "Enable Gamut Mode"
    default n
    help
        Provide realtek turnkey gamut.

config RTK_SW_OUTGAMMA_CT
    bool "Enable software output gamma color tempurature"
    default n
    help
        Provide realtek turnkey software output gamma color tempurature.

config SUPPORT_COLORSYSTEM_MANUAL_SET
    bool "Enable support manual change Colorsystem display didn't No Signal"
    default n
    help
        Enable support manual change Colorsystem display didn't No Signal.
		
config BYPASSMEMC_FOR_CODESIZE_SAVING
    bool "BYPASSMEMC FOR CODESIZE SAVING"
    default n
    help
        Provide realtek MEMC.        

config SUPPORT_SRC_DPRX
	bool "Support Source DPRX"
	depends on RTK_DPRX
	default y
	help
		SUPPORT Source DPRX
```

## drivers/rtk_kdriver/tvscalercontrol/rtd6702/hdmirx/bist/Kconfig
```kconfig
config HDMI_RX_BUILT_IN_TEST
	bool "Enable HDMI RX Built in test"
	default n
	help
		Enable HDMI RX Built in test.

choice
	prompt "HDMI RX Test Case"
	depends on HDMI_RX_BUILT_IN_TEST
	default HDMI_RX_TEST

config STANDALONE_HDMI_RX_TEST
	bool "Standalone HDMI RX test (without scaler)"
	default n
	help
		HDMI RX Built in test.

config ZEBU_HDMI_21_RX_BUILT_IN_TEST
	bool "Zebu HDMI 2.1 RX Built in test"
	default n
	help
		Zebu HDMI 2.1 RX Built in test.

endchoice 
```

## drivers/rtk_kdriver/tvscalercontrol/rtd6748/Kconfig
```kconfig
config SUPPORT_SCALER
	tristate "Scaler Driver"
	default y
	select RTK_HDMI_RX
	help
		SUPPORT Scaler Driver

config USE_SHARE_COMMON
    bool "Use Share Common"
    default n
    help
        SUPPORT New Common

config KDRIVER_USE_NEW_COMMON
    bool "Use New Common"
    default y
    help
        SUPPORT New Common

config HDCP2_USE_DEFAULT_HDCP_KEY
	bool "HDCP2 Use default HDCP Key"
	default n
	help
		Use default HDCP Key for bringup

if SUPPORT_SCALER
config SUPPORT_SRC_ADC
	bool "Support Source ADC"
	default n
	help
		SUPPORT Source ADC

if SUPPORT_SRC_ADC
config SUPPORT_SRC_VGA
	bool "Support Source VGA"
	default y
	help
		SUPPORT Source VGA
endif

config ENABLE_3D_SETTING
	bool "Enable VDC 3D YC Separation"
	default y
	help
		3D YC Separation

config DYNAMIC_ALLOCATION_SCALER_MEMORY
	bool "Enable dynamic memory allocation"
	default y
	help
		SUPPORT memory dynamic allocation

config DUAL_CHANNEL
	bool "Enable dual channel"
	default y
	help
		dual chanel open for pip


config ENABLE_VD_27MHZ_MODE
	bool "Enable VD 27MHz mode"
	default y
	help
		enable VD 27MHz mode

config FIX_CKILL_MODE
	bool "Fix ckill mode"
	default y
	help
		Fix ckill mode
endif

config RTK_KDRV_HDMI_ENABLE_V4L2
	bool "Enable HDMI V4L2 Support"
	default y
	help
	  Enable HDMI V4L2 Support

config RTK_KDRV_SVP_HDMI_PROTECTION
	bool "Enable HDMI secure protection"
	depends on OPTEE_SECURE_SVP_PROTECTION
	default n
	help
	  Enable HDMI secure protection

config MEMC
    bool "Enable MEMC"
    default n
    help
        Provide realtek MEMC.

config SUPPORT_SDR_MAX_RGB
	bool "support SDR max RGB"
	default y
	help
	  Enable support SDR max RGB		

config SUPPORT_IPQ
	bool "support IPQ"
	default y
	help
	  Enable support IPQ

config OSD_VALUE_NO_NEED_MAP_RANGE
	bool "OSD VALUE NO NEED MAP RANGE"
	default n
	help
	  Enable OSD VALUE NO NEED MAP RANGE

config RTK_GAMUT_SUPPORT
    bool "Enable Gamut Mode"
    default y
    help
        Provide realtek turnkey gamut.

config RTK_SW_OUTGAMMA_CT
    bool "Enable software output gamma color tempurature"
    default y
    help
        Provide realtek turnkey software output gamma color tempurature.

config SUPPORT_COLORSYSTEM_MANUAL_SET
    bool "Enable support manual change Colorsystem display didn't No Signal"
    default n
    help
        Enable support manual change Colorsystem display didn't No Signal.

config DYNAMIC_PANEL_SELECT
    bool "Enable DLG support"
    default n
    help
        Provide DLG support.
		
config BYPASSMEMC_FOR_CODESIZE_SAVING
    bool "BYPASSMEMC FOR CODESIZE SAVING"
    default n
    help
        Provide realtek MEMC.
```

## drivers/rtk_kdriver/usb/Kconfig
```kconfig
menu "RTK USB Driver"

config RTK_KDRV_USB
    tristate "RTK USB driver support"
    depends on USB

config RTK_KDRV_XHCI_HCD_PLATFORM
    tristate "RTK XHCI HCD Platform support"
    depends on USB_XHCI_HCD
    help
      Said Y to enable XHCI controller.

config RTK_KDRV_XHCI_SAVE_POWER_WHEN_NO_U3
    bool "Save power consumption when USB3.0 is not in use"
    depends on RTK_KDRV_XHCI_HCD_PLATFORM
    help
    Some platforms have no U3 port.
    To power off this function can reduce power consumption.
	Said Y to disable U3 function.

config RTK_KDRV_EHCI_HCD_PLATFORM
    tristate "RTK EHCI HCD Platform support"
    depends on USB_EHCI_HCD
    help
      Said Y to enable EHCI controller.

config RTK_KDRV_OHCI_HCD_PLATFORM
    tristate "RTK OHCI HCD Platform support"
    depends on USB_OHCI_HCD
    help
      Said Y to enable OHCI controller.


#config RTK_RESUME_SEQ_FOR_USB_DONGLE
#    tristate "Put wifi dongle as the last resume device"
#    depends on RTK_KDRV_USB
#    help
#      Some external devices (such as fixed WIFI) will prolong the boot time.
#      Put these devices in the last initialization to speed up the boot
#      Said Y to enable.

config RTK_KDRV_XHCI_DRD_PLATFORM
    tristate "RTK XHCI DRD Platform support"
    depends on USB_XHCI_HCD
    select USB_GADGET
    select USB_DWC3
    select USB_DWC3_GADGET
    select RTK_KDRV_XHCI_HCD_PLATFORM
    help
      Said Y to enable XHCI controller.

config RTK_KDRV_USB_OTG_PLATFORM
    tristate "RTK USB OTG Platform support"
    select USB_GADGET
    select USB_DWC2
    select USB_DWC2_PERIPHERAL
    help
      Said Y to enable XHCI controller.

endmenu
```

## drivers/rtk_kdriver/vad/Kconfig
```kconfig
config RTK_KDRV_VAD
	tristate "Driver for VAD Manager"
	default n
	help
	  Driver for VAD Manager
```
