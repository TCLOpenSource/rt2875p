## drivers/rtk_kdriver/gal/rtd2851a/Kconfig
```kconfig
#SE driver
config RTK_KDRV_SE
	bool "SE (2D Graphic/Streaming Engine) Driver."
	depends on RTK_KDRIVER_SUPPORT
	select RTK_KDRIVER
	default n
	help
		For drawing

#GDMA drvier
config RTK_KDRV_GDMA
	bool "GDMA Driver"
	depends on RTK_KDRIVER_SUPPORT
	select RTK_KDRIVER
	default n
	help
		For display

#GDMA drvier
config RTK_KDRV_GDMA_RLINK
       bool "GDMA Rlink Driver"
       depends on RTK_KDRIVER_SUPPORT
       select RTK_KDRIVER
       default n
       help
               For display

#GAL driver
config RTK_KDRV_GAL
	bool "GAL Driver"
	depends on RTK_KDRIVER_SUPPORT && RTK_KDRV_SE && RTK_KDRV_GDMA && ION_REALTEK
	select RTK_KDRIVER
	default n
	help
		For kadapter
```

## drivers/rtk_kdriver/hdcp/Kconfig
```kconfig
config RTK_HDCP_OPTEE
    tristate "Enable HDCP OPTEE"
    default n
    help
        Enable HDCP OPTEE

config OPTEE_HDCP2
    bool "Enable OPTEE_HDCP2"
    default n
    help
        Enable OPTEE_HDCP2

config OPTEE_HDCP14
    bool "Enable OPTEE_HDCP14"
    default n
    help
        Enable OPTEE_HDCP14
```

## drivers/rtk_kdriver/hdmitx/Kconfig
```kconfig
menu "HDMI TX"
#########################################
config TX_CHANGE_TIMING
        bool "hdmitx timing change"
                default y
choice
       prompt "choose which Timing as default HDMITX output"
       help
        choose HDMI TX default timing for different project.
       config 8kp60_HDMI21
          bool "8kp60_HDMI2.1"
       help
         output 8kp60 with HDMI 2.1

       config 4kp60_HDMI21
          bool "4kp60_HDMI2.1"
       help
         output 4kp60 with HDMI 2.1

       config 4kp60_HDMI20
          bool "4kp60_HDMI2.0"
       help
         output 4kp60 with HDMI 2.0

       config 2kp60_HDMI20
          bool "2kp60_HDMI2.0"
       help
         output 2kp60 with HDMI 2.0
endchoice

config HDMITX_OUTPUT_DEFAULT_TIMING
        int
        range 0 3
        default 0 if 4kp60_HDMI20
        default 1 if 4kp60_HDMI21
        default 2 if 8kp60_HDMI21
        default 3 if 2kp60_HDMI20
        help
                choose output timing .
                   select 4kp60_HDMI20 if RTK_H5X_HDMITX_OUTPUT_TIMING=0
                   select 4kp60_HDMI21 if RTK_H5X_HDMITX_OUTPUT_TIMING=1
                   select 8kp60_HDMI21 if RTK_H5X_HDMITX_OUTPUT_TIMING=2
                   select 2kp60_HDMI20 if RTK_H5X_HDMITX_OUTPUT_TIMING=3
                (backward compatible.)

#########################################
config HDMITX_OUTPUT_CONFIG
        bool "HDMITX output port config"
                default n
choice
       prompt "Select HDMITX output to HDMIRX port number"
       default HDMIRX_PORT_4
       help
        Select HDMITX output to HDMIRX port number for different project.
       config HDMIRX_PORT_NONE
          bool "No Limit"
       help
         Don't limit HDMITX output to HDMIRX port number
       config HDMIRX_PORT_1
          bool "HDMIRX Port1"
       help
         Limit HDMITX output to HDMIRX Port1
       config HDMIRX_PORT_2
          bool "HDMIRX Port2"
       help
         Limit HDMITX output to HDMIRX Port2
       config HDMIRX_PORT_3
          bool "HDMIRX Port3"
       help
         Limit HDMITX output to HDMIRX Port3
       config HDMIRX_PORT_4
          bool "HDMIRX Port4"
       help
         Limit HDMITX output to HDMIRX Port4
endchoice

config HDMIRX_CONNECT_PORT_NUMBER
        int
        range 0 4
        default 0 if HDMIRX_PORT_NONE
        default 1 if HDMIRX_PORT_1
        default 2 if HDMIRX_PORT_2
        default 3 if HDMIRX_PORT_3
        default 4 if HDMIRX_PORT_4
        help
                limit hdmitx output to hdmirx port number
                   select HDMIRX_PORT_NONE if Don't Limit HDMITX output
                   select HDMIRX_PORT_1 if Limit HDMITX output to HDMIRX port1
                   select HDMIRX_PORT_2 if Limit HDMITX output to HDMIRX port2
                   select HDMIRX_PORT_3 if Limit HDMITX output to HDMIRX port3
                   select HDMIRX_PORT_4 if Limit HDMITX output to HDMIRX port4
                (backward compatible.)

#########################################
config HDMITX_LANE_SWAP_CONFIG
        bool "HDMITX Lane Swap config"
                default y
choice
       prompt "Select HDMITX Lane Swap config"
       default HDMIRX_LANE_SWAP_H5D_DEFAULT
       help
        Select HDMITX lane swap for different project.
       config HDMIRX_LANE_SWAP_H5D_DEFAULT
          bool "Lane CK/C/B/A mapping to src 3/2/1/0"
       help
         HDMITX lane CK/C/B/A mapping to src 3/2/1/0 (for H5D demo/LGE dongle)
       config HDMIRX_LANE_SWAP_H5D_ONE_BOARD
          bool "Lane CK/C/B/A mapping to src 2/3/0/1"
       help
         HDMITX lane CK/C/B/A mapping to src 2/3/0/1 (for LGE one board)
endchoice

config HDMITX_LANE_SRC_SEL
        int
        default 228 if HDMIRX_LANE_SWAP_H5D_DEFAULT
        default 177 if HDMIRX_LANE_SWAP_H5D_ONE_BOARD
        help
                hdmitx lane source select
                   select HDMIRX_LANE_SWAP_H5D_DEFAULT for H5D demo or LGE dongle project (3<<6|2<<4|1<<2|0 = 0xe4=228)
                   select HDMIRX_LANE_SWAP_H5D_ONE_BOARD for LGE one board project (2<<6| 3<<4| 0<<2| 1 = 0xb1=177)
                (backward compatible.)

#########################################
config HDMITX_PN_SWAP_CONFIG
        bool "HDMITX PN Swap config"
                default y
choice
       prompt "Select HDMITX PN Swap config"
       default HDMIRX_PN_SWAP_NONE
       help
        Select HDMITX PN swap for different project.
       config HDMIRX_PN_SWAP_NONE
          bool "Lane 0/1/2/3 PN NOT swap"
       help
         HDMITX lane 0/1/2/3 NOT swap (for H5D demo/LGE dongle/LGE one board)
       config HDMIRX_PN_SWAP_F
          bool "Lane all of 0/1/2/3 need do PN swap"
       help
         HDMITX lane Lane all of 0/1/2/3 need do PN swap (for Mac6p combo board)
endchoice

config HDMITX_LANE_PN_SWAP_CFG
        int
        default 0 if HDMIRX_PN_SWAP_NONE
        default 15 if HDMIRX_PN_SWAP_F
        help
                hdmitx lane source select
                   select HDMIRX_PN_SWAP_NONE for H5D demo or LGE dongle or LGE one board project
                   select HDMIRX_PN_SWAP_F for Mac6p combo board project
                (backward compatible.)

#########################################
config HDMITX_CHECK_EDID_INFO
    bool "HDMITX EDID Info Check"
            default n
    help
        Support check EDID to enable HDMITX output

config HDMITX_SHOW_PATTERN_ENABLE
    bool "HDMITX Show Colorbar Pattern when boot up"
            default n
    help
        Support HDMITX show colorbar pattern when boot up

config HDMITX_TOGGLE_PATTERN_PATTERN
    bool "HDMITX Toggle Colorbar Pattern when boot up"
            default n
    help
        Support HDMITX toggle colorbar pattern when boot up

config HDMITX_BYPASS_LINK_TRAINING
    bool "HDMITX force bypass HPD/EDID/Link Training control flow"
            default n
    help
        Support force bypass HPD/EDID/Link Training control flow (ONLY FOR SPECIAL HDMIRX)

config HDMITX_HDCP22_ENABLE
    bool "HDMITX HDCP22 function enable"
            default n
    help
        Support HDCP22 function enable when boot up

endmenu
```

## drivers/rtk_kdriver/hw_monitor/Kconfig
```kconfig
menuconfig RTK_KDRV_HW_MONITOR
	tristate "HW_MONITOR support"
	depends on RTK_KDRIVER_SUPPORT
	default y
	help
	  This option adds Realtek HW Monitor support.


if  RTK_KDRV_HW_MONITOR

# SB2
config RTK_KDRV_SB2
	tristate "SB2 Driver"
	default n
	help
	  System Bridge II Driver


config REALTEK_ARM_WRAPPER
	tristate "ARM WRAPPER Detector Enable"
	default n
	help
	  support ARM WRAPPER Detector

config REALTEK_ARM_WRAPPER_MONITOR_TEXT
	bool "ARM WRAPPER monitor text"
	depends on REALTEK_ARM_WRAPPER
	default n
	help
	  support ARM WRAPPER monitor text

#Memory Trash Detecter
config RTK_KDRV_DC_MEMORY_TRASH_DETCTER
	tristate "DCU Memory Trash Detector"
	default n
	help
	  Memory Trash Detecter

endif
```

## drivers/rtk_kdriver/irtx/core/Kconfig
```kconfig
config RTK_KDRV_IRTX
	bool "IRTX Support"
	
config RTK_KDRV_IRTX_CHARDEV
	bool "IRTX device interface"
	depends on RTK_KDRV_IRTX
	help
	  Say Y here to use irtx-* device files, usually found in the /dev/irtx/
	  directory on your system.  They make it possible to have user-space
	  programs use the IRTX bus.

	  This support is also available as a module.  If so, the module 
	  will be called irtx-dev.
```

## drivers/rtk_kdriver/japan4k_dmx/Kconfig
```kconfig
config RTK_KDRV_JP4K
	bool "Enable Realtek JAPAN4k DMX Driver"
	default n
	help
	  Say Y here if you want to support japan4k demux on your platform
```

## drivers/rtk_kdriver/leds/Kconfig
```kconfig
config RTK_KDRV_GPIO_LED
    tristate "RTK_KDRV_GPIO_LED"
    depends on RTK_KDRV_LEDS
    depends on LEDS_CLASS
    depends on NEW_LEDS
    default y
    help
        RTK GPIO LED

config RTK_KDRV_I2C_LED
    bool "RTK_KDRV_I2C_LED"
    default n
    help
        RTK GOOGLE VOICE i2c LED

config RTK_KDRV_SERIAL_LED
    tristate "RTK_KDRV_SERIAL_LED"
    default n
    help
        RTK GOOGLE VOICE SERIAL LED

#source "drivers/rtk_kdriver/leds/trigger/Kconfig"
```

## drivers/rtk_kdriver/leds/trigger/Kconfig
```kconfig
# SPDX-License-Identifier: GPL-2.0-only
menuconfig LEDS_TRIGGERS
	bool "LED Trigger support"
	depends on LEDS_CLASS
	help
	  This option enables trigger support for the leds class.
	  These triggers allow kernel events to drive the LEDs and can
	  be configured via sysfs. If unsure, say Y.

if LEDS_TRIGGERS

config RTK_LEDS_TRIGGER_TIMER
	tristate "LED Timer Trigger"
	help
	  This allows LEDs to be controlled by a programmable timer
	  via sysfs. Some LED hardware can be programmed to start
	  blinking the LED without any further software interaction.
	  For more details read Documentation/leds/leds-class.rst.

	  If unsure, say Y.

config RTK_LEDS_TRIGGER_ONESHOT
	tristate "LED One-shot Trigger"
	help
	  This allows LEDs to blink in one-shot pulses with parameters
	  controlled via sysfs.  It's useful to notify the user on
	  sporadic events, when there are no clear begin and end trap points,
	  or on dense events, where this blinks the LED at constant rate if
	  rearmed continuously.

	  It also shows how to use the led_blink_set_oneshot() function.

	  If unsure, say Y.

config RTK_LEDS_TRIGGER_GPIO
	tristate "LED GPIO Trigger"
	depends on GPIOLIB || COMPILE_TEST
	help
	  This allows LEDs to be controlled by gpio events. It's good
	  when using gpios as switches and triggering the needed LEDs
	  from there. One use case is n810's keypad LEDs that could
	  be triggered by this trigger when user slides up to show
	  keypad.

	  If unsure, say N.

endif # LEDS_TRIGGERS
```

## drivers/rtk_kdriver/mcp/Kconfig
```kconfig
menu "MCP HW Crypto Engine Support"

# CP
config RTK_KDRV_MCP
        tristate "MCP Driver."
        depends on RTK_KDRIVER_SUPPORT
        select RTK_KDRIVER
        default n

config RTK_KDRV_RCP_TEST
        bool "Support CP Register Mode Cryption Self Test"
        depends on RTK_KDRV_MCP
        default n
        help
          CP Register mode Driver Self Test 

config RTK_KDRV_MCP_NAPI
        bool "MCP New API"
        depends on RTK_KDRV_MCP
        default y
        help
          MCP New API Driver

config RTK_KDRV_MCP_SHA256
        bool "Support MCP SHA256"
        depends on RTK_KDRV_MCP
        default y
        help
          MCP SHA256 Driver

source "drivers/rtk_kdriver/mcp/rsa/Kconfig"

endmenu
```

## drivers/rtk_kdriver/mcp/rsa/Kconfig
```kconfig
menu "RSA function Support"

config RTK_KDRV_MCP_RSA
        bool "Support MCP RSA"
        select MPILIB
        select CRYPTO_RSA
        default n
        help
          MCP RSA Driver

config RTK_KDRV_MCP_RSA_TEST
        bool "Support MCP RSA Test"
        depends on RTK_KDRV_MCP_RSA && RTK_KDRV_MCP
        default n
        help
          MCP RSA Driver Self Test
endmenu
```

## drivers/rtk_kdriver/measure/Kconfig
```kconfig
menu "MEASURE"

config RTK_MEASURE
	tristate "Enable measure Support"
	default y
	help
		Enable measure

endmenu
```

## drivers/rtk_kdriver/mmc/Kconfig
```kconfig
menu "RTK MMC Driver"

config MMC_RTKEMMC_PLUS
    tristate "Realtek EMMC PLUS Host Driver"
    depends on MMC && MMC_BLOCK
    help
      This selects Realtek EMMC PLUS controller.

      If unsure, say N.

config RTKEMMC_HS200
    tristate "Realtek EMMC HS200 Function"
    depends on MMC_RTKEMMC_PLUS
    help
      This is HS200 SDR function enable.

      If unsure, say N.

config RTKEMMC_HS400
    tristate "Realtek EMMC HS400(HS200 DDR) Function"
    depends on RTKEMMC_HS200
    help
      This is HS200 DDR function enable.

      If unsure, say N.

config RTKEMMC_HS200_CLOCK
	int "Clock runing on HS200 SDR & DDR, Mhz"
	depends on RTKEMMC_HS200 || RTKEMMC_HS400
	range 50  200
	default 120
	help
	  clock runing on HS200 mode.
	  Form clock 50Mhz to 200Mhz.
	  Default is 150Mhz.

	  If unsure, say 150 here.

config MMC_RTKEMMC_SHOW_EXTCSD
    tristate "show eMMC EXT_CSD."
    depends on MMC_RTKEMMC_PLUS
    help
      show eMMC EXT_CSD when initial flow.

      If unsure, say N.

config MMC_RTKEMMC_HK_ATTR
    tristate "EMMC extra function."
    depends on MMC_RTKEMMC_PLUS
    help
      Open hacking command function.
      this funcion can modify ext_csd and other function.

      If unsure, say N.

config MMC_RTKEMMC_VENDOR_IOCTL
    tristate "enable ioctl function of RTK."
    depends on MMC_RTKEMMC_PLUS
    help
      show enable ioctl function of RTK.

      If unsure, say N.

config MMC_RTKEMMC_RST_N_ENABLE
    tristate "enable eMMC HW reset function on ext_csd."
    depends on MMC_RTKEMMC_PLUS
    help
      enable eMMC HW reset function on ext_csd.

      If unsure, say N.

config MMC_HW_SEMAPHORE
    tristate "enable eMMC HW semaphore."
    depends on MMC_RTKEMMC_PLUS
    help
      enable eMMC HW rsemaphore.

      If unsure, say N.

config RTKEMMC_COWORK_WITH_KCPU
    tristate "enable eMMC cowork with kcpu."
    depends on MMC_RTKEMMC_PLUS
    help
      enable eMMC cowork with kcpu.

      If unsure, say N.

config MMC_RTKSD
    tristate "Realtek MMC/SD Host Driver"
    depends on MMC && MMC_BLOCK
    help
      This selects Realtek MMC/SD card reader.

      If unsure, say N.

endmenu
```

## drivers/rtk_kdriver/pcie/Kconfig
```kconfig
menu "RTK PCIE RC Driver "


config RTK_KDRV_PCIE
	tristate "REALTEK TV PCIe controller"
	select PCI_MSI_IRQ_DOMAIN
	select PCIE_DW_HOST
	help
	  Say Y here if you want support for DesignWare core based PCIe host
	  controller found in REALTEK TV SoC.

endmenu
```

## drivers/rtk_kdriver/platform/tv006/Kconfig
```kconfig
menu "Platform dependent drivers (TV006)"
depends on CUSTOMER_TV006

config RTK_KDRV_GPIO_WDT_DEBUG_LOG
        bool "Enable GPIO Interrupt for WDT Debug"
        select RTK_KDRV_GPIO
        default y

endmenu
```

## drivers/rtk_kdriver/power/Kconfig
```kconfig
if POWER_SUPPLY

config RTK_POWER
	tristate "Realtek power driver"
	help
	  This driver is used for realtek testing. It's safe to say M here.

	  Choose this option if you want to monitor battery status on
	  Compaq/HP iPAQ h3100 and h3600.

endif # POWER_SUPPLY
```

## drivers/rtk_kdriver/quick_show/Kconfig
```kconfig
config RTK_KDRV_QUICKSHOW
	tristate "Quick-Show driver"
	help
	  This quick show driver is for RTK quick-show feature

	  If unsure, say N.
```
