## drivers/rtk_kdriver/rmm/Kconfig
```kconfig
config REALTEK_MEMORY_MANAGEMENT
	tristate "Realtek memory management"
	default y
	help
		Code added for Realtek memory management

config CMA_RTK_ALLOCATOR
	bool "Use RTK blueprint"
	default y
	depends on REALTEK_MEMORY_MANAGEMENT
	help
	  Use RTK blueprint to replace bitmap allocator.

config CMA_FIRST_POLICY
	bool "Use CMA memory first"
	default n
	depends on REALTEK_MEMORY_MANAGEMENT
	help
	  Use CMA memory first if user allocate movable memory.

config REALTEK_MANAGE_OVERLAPPED_REGION
	bool "Manage the memory region overlapped by RBUS & NOR."
	default n
	depends on CMA_RTK_ALLOCATOR && REALTEK_MEMORY_MANAGEMENT
	help
		Put the memory region overlapped by RBUS & NOR under the control of linux.

config REALTEK_DEV_MEM
	tristate "Provide the /dev/rtkmem interface."
	default n
	help
		Provide an interface to replace /dev/mem.

source "drivers/rtk_kdriver/rmm/dma-buf/Kconfig"
source "drivers/rtk_kdriver/rmm/ion/Kconfig"
```

## drivers/rtk_kdriver/rmm/dma-buf/Kconfig
```kconfig
config DMABUF_HEAPS_DVR
	tristate "DMA-BUF DVR heap support"
	depends on DMABUF_HEAPS && DMA_CMA && REALTEK_MEMORY_MANAGEMENT
	help
	  Choose this option to enable DVR heaps with DMA-BUF. This heap is backed
	  by the RTK CMA serials APIs.

config DMABUF_CARVEOUT_HEAP
    tristate "DMA-BUF carveout heap support"
	depends on DMABUF_HEAPS && REALTEK_MEMORY_MANAGEMENT
    help
      Choose this option to enable carveout heaps with DMA-BUF. Carveout heaps
      are backed by memory reserved from the system. Allocation times are
      typically faster at the cost of memory not being used. Unless you
      know your system has these regions, you should say N here.

config DMABUF_HEAPS_VBM
	tristate "DMA-BUF VBM Heap"
	depends on DMABUF_HEAPS && DMA_CMA && REALTEK_MEMORY_MANAGEMENT
	help
	  Choose this option to enable dma-buf VBM heaps. This heap is backed
	  by the RTK CMA serials APIs and using VBM.
```

## drivers/rtk_kdriver/rmm/ion/Kconfig
```kconfig
# SPDX-License-Identifier: GPL-2.0
config ION_DVR_HEAP
	tristate "Ion DVR heap support"
	depends on ION && REALTEK_MEMORY_MANAGEMENT
	help
	  Choose this option to enable DVR heaps with Ion. This heap is backed
	  by the RTK CMA serials APIs.
```

## drivers/rtk_kdriver/rtice/Kconfig
```kconfig
menu "Realtek RTICE stub" 

config RTK_KDRV_RTICE
	tristate "Use Realtek RTICE stub driver"
	depends on RTK_KDRIVER_SUPPORT
	default y
	help
		RTICE stub driver
		
#=================================================================
		
config RTK_KDRV_RTICE_SYSTEM_TOOL
        bool "RTICE System Utilities"
        depends on RTK_KDRV_RTICE
        default y
        help
          RTICE System utility allows user to access system infomation
 
config RTK_KDRV_RTICE_IOMEM_TOOL
        bool "RTICE IO/MEM Utilities"
        depends on RTK_KDRV_RTICE
        default y
        help
          RTICE IO/MEM utility allows user to access io/mem 
          
config RTK_KDRV_RTICE_I2C_TOOL
        bool "RTICE I2C Tool driver"
        depends on RTK_KDRV_RTICE && I2C
        default y
        help
          RTICE I2C Tool allows user to access i2c via RTICE
          
config RTK_KDRV_RTICE_AP_TOOL
        bool "RTICE AP DEBUG Tool driver"
        depends on RTK_KDRV_RTICE
        default y
        help
          RTICE AP DEBUG Tool allows user to access ap ID value
	  
config RTK_KDRV_RTICE_BW_CHECK
        bool "RTICE BW Check Tool driver"
        depends on RTK_KDRV_RTICE
        default y
        help
          RTICE BW Check Tool allows user to start bw checking flow and query bw value of checked ip. 		

config RTK_KDRV_RTICE_DMA_STATUS
        tristate "RTICE2 DMA Status Tool driver"
        depends on RTK_KDRV_RTICE
        default y
        help
          RTICE DMA Status Tool allows user to query info about DMA of checked ip.
 
config RTK_KDRV_RTICE_MC_MEASURE
        tristate "RTICE MC Measure Tool driver"
        depends on RTK_KDRV_RTICE
        default y
        help
          RTICE MC Measure Tool allows user to query info about MC read or write count.
          
config RTK_KDRV_RTICE_ADDR_TOGGLE
        tristate "RTICE Address toggle Tool driver"
        depends on RTK_KDRV_RTICE
        default y
        help
          RTICE Address toggle Tool allows user to query address toggle count. 
endmenu
```

## drivers/rtk_kdriver/rtk_cec/Kconfig
```kconfig
#Copyright (C) 2007-2013 Realtek Semiconductor Corporation.
# drivers/cec/Kconfig

config RTK_KDRV_CEC
	tristate "rtk cec driver based on cec framework"
	default n
	select MEDIA_CEC_SUPPORT
	select CEC_CORE
	help
	  rtk cec driver based on cec framework
	
```

## drivers/rtk_kdriver/rtk_drm/Kconfig
```kconfig
config DRM_REALTEK
	tristate "DRM Support for Realtek SoCs"
	depends on DRM && RTK_KDRV_GDMA
	select DRM_GEM_CMA_HELPER
    select DRM_GEM_SHMEM_HELPER
	select DRM_KMS_HELPER
    default n
	help
	  The module will be called rtk_drm
	  This driver provides kernel mode setting and
	  buffer management to userspace.
```

## drivers/rtk_kdriver/rtk_typec/Kconfig
```kconfig
config RTK_KDRV_USB_HUB
    tristate "RTK USB HUB driver support releated with typec appliaction"
    default n
    depends on USB
       

config RTK_KDRV_USB_BB
    tristate "RTK USB HUB driver support releated with typec appliaction"
    default n
    depends on USB
```

## drivers/rtk_kdriver/smartcard/Kconfig
```kconfig
# drivers/cec/Kconfig

menu "Smart Card Interface Support"

config RTK_KDRV_SMARTCARD
	tristate "Smart Card Interface Support"
	default n
	help
	  Say Y here if you want to support smart card on your platform

#source "drivers/rtk_kdriver/smartcard/core/Kconfig"
#source "drivers/rtk_kdriver/smartcard/adapter/Kconfig"

endmenu

# drivers/smartcard/core/Kconfig

config RTK_KDRV_SMARTCARD_CHARDEV
	bool "Smart Card Device Interface"
	depends on RTK_KDRV_SMARTCARD
	select RTK_KDRV_SMARTCARD_DEV_FILE
	default y
	help
	  Say Y here to use smart card device files, usually found in the /dev/smartcard/
	  directory on your system.  They make it possible to have user-space
	  programs use the smart card reader.

config RTK_KDRV_SMARTCARD_DEV_FILE
	bool 
	depends on RTK_KDRV_SMARTCARD
	default y

config RTK_KDRV_SMARTCARD_DEBUG
	bool "Smart Card Debug Mode"
	depends on RTK_KDRV_SMARTCARD
	default y
	help
	  If you want to enable smart card debug message, say Y.
# drivers/Kconfig

config RTK_KDRV_MIO_SMARTCARD
	bool "Smart Card MIO Mode"
	depends on RTK_KDRV_SMARTCARD && RTK_KDRV_MIO
	default n
	help
	  If you want to use MIO smart card , say Y.

comment"Smart Card Interface"
	depends on RTK_KDRV_SMARTCARD

config RTK_KDRV_SMARTCARD_IFD
	tristate "Realtek  Smart Card Interface"
	depends on RTK_KDRV_SMARTCARD 
	select RTK_KDRV_GPIO
	default y
	help
	  If you want to use smart card on board, say Y.
```
